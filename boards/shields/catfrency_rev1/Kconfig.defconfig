## boards/shields/catfrency_rev1/Kconfig.defconfig
```kconfig
if SHIELD_CATFRENCY_REV1_LEFT

config ZMK_KEYBOARD_NAME
    default "catfrency-rev1"

config ZMK_SPLIT_ROLE_CENTRAL
    default y

endif # SHIELD_CATFRENCY_REV1_LEFT

if SHIELD_CATFRENCY_REV1_LEFT || SHIELD_CATFRENCY_REV1_RIGHT

config ZMK_SPLIT
    default y

endif # SHIELD_CATFRENCY_REV1_LEFT || SHIELD_CATFRENCY_REV1_RIGHT
```

## boards/shields/catfrency_rev1/Kconfig.shield
```kconfig
config SHIELD_CATFRENCY_REV1_LEFT
    def_bool $(shields_list_contains,catfrency_rev1_left)

config SHIELD_CATFRENCY_REV1_RIGHT
    def_bool $(shields_list_contains,catfrency_rev1_right)
```
